## board/rocketchip/vc709/Kconfig
```kconfig
if TARGET_ROCKETCHIP_VC709

config SYS_BOARD
	default "vc709"

config SYS_VENDOR
	default "rocketchip"

config SYS_CPU
	default "generic"

config SYS_CONFIG_NAME
	default "vc709"

config SYS_TEXT_BASE
	default 0x80000000

config BOARD_SPECIFIC_OPTIONS # dummy
	def_bool y
	select GENERIC_RISCV
	imply SMP
	imply BOARD_LATE_INIT
	imply SPI
	imply SPI_SIFIVE
	imply MMC
	imply MMC_SPI
	imply MMC_BROKEN_CD
	imply CMD_MMC
	imply SIFIVE_CACHE
	imply SIFIVE_CCACHE
	imply SIFIVE_SERIAL
	imply DM_GPIO
	imply SIFIVE_GPIO
	imply CMD_GPIO
	imply MISC
	imply SIFIVE_OTP
	imply DM_PWM
	imply PWM_SIFIVE
	imply DM_I2C
	imply SYS_I2C_OCORES
	imply SPL_I2C
endif
```

## configs/rocketchip_vc709_defconfig
```kconfig
# copied from qemu defconfig
CONFIG_RISCV=y
CONFIG_NR_DRAM_BANKS=1
CONFIG_VERSION_VARIABLE=y
CONFIG_TARGET_ROCKETCHIP_VC709=y
CONFIG_ARCH_RV64I=y
CONFIG_DISTRO_DEFAULTS=y
CONFIG_DISPLAY_CPUINFO=y
CONFIG_DISPLAY_BOARDINFO=y
CONFIG_SYS_RELOC_GD_ENV_ADDR=y
CONFIG_CMD_MEMINFO=y
CONFIG_REGEX=y
CONFIG_CMD_CONFIG=y
CONFIG_CMD_LICENSE=y
CONFIG_CMD_SBI=y
CONFIG_CMD_ADTIMG=y
CONFIG_CMD_ASKENV=y
CONFIG_CMD_GREPENV=y
CONFIG_CMD_ERASEENV=y
CONFIG_CMD_BINOP=y
CONFIG_CMD_BIND=y
CONFIG_CMD_CLK=y
CONFIG_CMD_CLONE=y
CONFIG_CMD_READ=y
CONFIG_CMD_SAVES=y
CONFIG_CMD_SDRAM=y
CONFIG_CMD_UUID=y
CONFIG_CMD_DHRYSTONE=y
CONFIG_CMD_ELF=y
CONFIG_CMD_DEMO=y
CONFIG_DM_DEMO=y
CONFIG_DM_DEMO_SIMPLE=y
CONFIG_DM_DEMO_SHAPE=y
CONFIG_BLK=y

# env
CONFIG_ENV_SIZE=0x20000
CONFIG_ENV_VARS_UBOOT_RUNTIME_CONFIG=y
CONFIG_CMD_ENV_CALLBACK=y
CONFIG_CMD_ENV_FLAGS=y

# UEFI
CONFIG_EFI=y
CONFIG_EFI_LOADER=y
CONFIG_EFI_LOADER_BOUNCE_BUFFER=y
CONFIG_EFI_LOAD_FILE2_INITRD=y
CONFIG_EFI_STUB=y
CONFIG_EFI_STUB_64BIT=y
CONFIG_CMD_EFIDEBUG=y
CONFIG_CMD_NVEDIT_EFI=y
# CONFIG_CMD_IMLS=y

# boot timing
# CONFIG_BOOTSTAGE=y
CONFIG_SHOW_BOOT_PROGRESS=y

#
# Boot media
#
CONFIG_QSPI_BOOT=y
CONFIG_SD_BOOT=y
CONFIG_SPI_BOOT=y
CONFIG_SUPPORT_EMMC_BOOT=y

#
# Boot images
#
CONFIG_ANDROID_BOOT_IMAGE=y
CONFIG_FIT=y
CONFIG_FIT_FULL_CHECK=y
CONFIG_FIT_ENABLE_SHA256_SUPPORT=y
CONFIG_FIT_SHA384=y
CONFIG_FIT_SHA512=y
CONFIG_FIT_SIGNATURE=y
CONFIG_FIT_CIPHER=y
CONFIG_FIT_VERBOSE=y
CONFIG_FIT_BEST_MATCH=y
CONFIG_FIT_PRINT=y
CONFIG_LEGACY_IMAGE_FORMAT=y
CONFIG_SUPPORT_RAW_INITRD=y
# CONFIG_OF_BOARD_SETUP=y
# CONFIG_OF_SYSTEM_SETUP=y
CONFIG_OF_STDOUT_VIA_ALIAS=y
CONFIG_CHROMEOS=y
CONFIG_CHROMEOS_VBOOT=y

# Boot command
CONFIG_CMD_ABOOTIMG=y
CONFIG_CMD_BOOTCOUNT=y
CONFIG_CMD_BOOTD=y
CONFIG_CMD_BOOTM=y
CONFIG_BOOTM_EFI=y
CONFIG_CMD_BOOTZ=y
CONFIG_CMD_BOOTI=y
CONFIG_BOOTM_LINUX=y
CONFIG_BOOTM_NETBSD=y
CONFIG_BOOTM_PLAN9=y
CONFIG_BOOTM_RTEMS=y
CONFIG_BOOTM_VXWORKS=y
CONFIG_BOOTM_OPENRTOS=y
CONFIG_CMD_BOOTEFI=y
CONFIG_CMD_BOOTEFI_HELLO_COMPILE=y
CONFIG_CMD_BOOTEFI_HELLO=y
CONFIG_CMD_BOOTEFI_SELFTEST=y
CONFIG_CMD_BOOTEFI_BOOTMGR=y
CONFIG_CMD_BOOTMENU=y
CONFIG_CMD_BOOTSTAGE=y
CONFIG_CMD_SYSBOOT=y
CONFIG_CMD_ZBOOT=y

# compression
CONFIG_CMD_LZMADEC=y
CONFIG_CMD_UNLZ4=y
CONFIG_CMD_UNZIP=y
CONFIG_CMD_ZIP=y
CONFIG_GZIP=y
CONFIG_BZIP2=y
CONFIG_GETOPT=y
CONFIG_LZO=y
# CONFIG_ZSTD=y

# mmc
CONFIG_DM_MMC=y
CONFIG_CMD_LOADB=y
CONFIG_MMC=y
CONFIG_MMC_QUIRKS=y
CONFIG_MMC_DW=y
CONFIG_MMC_SDHCI=y
CONFIG_MMC_SDHCI_ADMA=y
CONFIG_MMC_SDHCI_AM654=y
CONFIG_MMC_SDHCI_ASPEED=y
CONFIG_MMC_SDHCI_ATMEL=y
CONFIG_MMC_SDHCI_BCM2835=y
# CONFIG_MMC_SDHCI_BCMSTB=y
CONFIG_MMC_SDHCI_CADENCE=y
CONFIG_MMC_SDHCI_F_SDH30=y
CONFIG_MMC_SDHCI_IPROC=y
CONFIG_MMC_SDHCI_MSM=y
CONFIG_MMC_SDHCI_PIC32=y
CONFIG_MMC_SDHCI_ROCKCHIP=y
# CONFIG_MMC_SDHCI_S5P=y
CONFIG_MMC_SDHCI_SDMA=y
# CONFIG_MMC_SDHCI_STI=y
CONFIG_MMC_SDHCI_XENON=y
CONFIG_MMC_IO_VOLTAGE=y
CONFIG_MMC_HW_PARTITIONING=y
CONFIG_MMC_WRITE=y
CONFIG_MMC_HS200_SUPPORT=y
CONFIG_MMC_HS400_ES_SUPPORT=y
CONFIG_MMC_HS400_SUPPORT=y
CONFIG_MMC_UHS_SUPPORT=y
# BRAND
CONFIG_MMC_MESON_GX=y
CONFIG_MMC_MTK=y
CONFIG_MMC_MXS=y
CONFIG_MMC_OCTEONTX=y
# CONFIG_MMC_OMAP36XX_PINS=y
# CONFIG_MMC_OMAP_HS_ADMA=y
# CONFIG_MMC_OMAP_HS=y
# CONFIG_MMC_PCI=y
CONFIG_MMC_PITON=y
CONFIG_MMC_PWRSEQ=y
CONFIG_CMD_BKOPS_ENABLE=y
CONFIG_CMD_MMC_SWRITE=y

# crypto
CONFIG_SHA512_ALGO=y
CONFIG_CRC32_VERIFY=y
CONFIG_MD5SUM_VERIFY=y
CONFIG_AES=y
CONFIG_ECDSA=y
CONFIG_ASYMMETRIC_KEY_TYPE=y
CONFIG_RSA=y
CONFIG_ECDSA_VERIFY=y
CONFIG_RSA_VERIFY_WITH_PKEY=y
CONFIG_LIBAVB=y

CONFIG_CMD_CRC32=y
CONFIG_CMD_MD5SUM=y
CONFIG_CMD_MEM_SEARCH=y
CONFIG_CMD_STRINGS=y

# run in s-mode
# as payload of opensbi
CONFIG_RISCV_SMODE=y
CONFIG_SYS_TEXT_BASE=0x80200000

# serial
CONFIG_SPECIFY_CONSOLE_INDEX=y
CONFIG_SERIAL_RX_BUFFER=y
CONFIG_SERIAL_SEARCH_ALL=y
CONFIG_SERIAL_PROBE_ALL=y
CONFIG_DEBUG_UART_ANNOUNCE=y

# early debug uart
CONFIG_DEBUG_UART=y
CONFIG_DEBUG_UART_SIFIVE=y
CONFIG_DEBUG_UART_BASE=0x64000000
CONFIG_DEBUG_UART_CLOCK=50000000
CONFIG_BAUDRATE=921600

#
# Memory commands
#
CONFIG_CMD_MEMTEST=y


# block device
CONFIG_HAVE_BLOCK_DEVICE=y

# MTD
CONFIG_MTD=y
CONFIG_DM_MTD=y
CONFIG_CMD_MTDPARTS=y

# partition
CONFIG_PARTITIONS=y
CONFIG_PARTITION_UUIDS=y
CONFIG_PARTITION_TYPE_GUID=y
CONFIG_MAC_PARTITION=y
CONFIG_ISO_PARTITION=y
CONFIG_AMIGA_PARTITION=y
CONFIG_EFI_PARTITION=y

# GPT
CONFIG_CMD_GPT=y
CONFIG_CMD_GPT_RENAME=y

# file system
# CONFIG_FS_BTRFS=y
CONFIG_FS_FAT=y
CONFIG_FAT_WRITE=y
CONFIG_CMD_FAT=y
CONFIG_CMD_FS_UUID=y
CONFIG_CMD_EXT4_WRITE=y
CONFIG_CMD_SQUASHFS=y
CONFIG_CMD_ZFS=y
CONFIG_CMD_NFS=n

# axi quad spi driver
CONFIG_SPI=y
CONFIG_SPI_FLASH=y
CONFIG_SPI_SIFIVE=y
CONFIG_CMD_SPI=y

# tca6416a gpio driver
CONFIG_DM_GPIO=y
CONFIG_SIFIVE_GPIO=y
CONFIG_CMD_GPIO=y

# utilities
CONFIG_CMD_FDT=y

# use embedded dtb
CONFIG_OF_SEPARATE=y
# CONFIG_OF_PRIOR_STAGE=y
CONFIG_DEFAULT_DEVICE_TREE="rocketchip-vc709"
CONFIG_DEFAULT_FDT_FILE="rocketchip/rocketchip-vc709.dtb"
```
